/ {
    chosen {
        zmk,kscan = &kscan;
    };
    kscan: kscan {
        compatible = "zmk,kscan-gpio-matrix";
        wakeup-source;
        diode-direction = "col2row";
        row-gpios = <
            &gpio0 21 (GPIO_PULL_DOWN | GPIO_ACTIVE_HIGH),
            &gpio0 20 (GPIO_PULL_DOWN | GPIO_ACTIVE_HIGH),
            &gpio0 4  (GPIO_PULL_DOWN | GPIO_ACTIVE_HIGH),
            &gpio0 5  (GPIO_PULL_DOWN | GPIO_ACTIVE_HIGH),
            &gpio0 6  (GPIO_PULL_DOWN | GPIO_ACTIVE_HIGH)
        >;
        col-gpios = <
            &gpio0 19 GPIO_ACTIVE_HIGH,
            &gpio0 18 GPIO_ACTIVE_HIGH,
            &gpio0 15 GPIO_ACTIVE_HIGH,
            &gpio0 14 GPIO_ACTIVE_HIGH,
            &gpio0 16 GPIO_ACTIVE_HIGH,
            &gpio0 10 GPIO_ACTIVE_HIGH,
            &gpio0 9  GPIO_ACTIVE_HIGH
        >;
    };
};
&left_encoder {
    status = "okay";
};
